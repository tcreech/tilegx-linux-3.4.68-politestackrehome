## arch/tile/drivers/Kconfig
```kconfig
config TILE_MEMPROF
	bool "Memory profiling support in /proc/tile/memprof"
	default y
	---help---
	  This device provides real-time information on memory utilization,
	  latency, etc.

config TILE_BME_MEM
	bool "Bare-Metal Environment memory-sharing interface"
	default y
	---help---
	  This device allows sharing memory between a BME application
	  running on some of the cores and Linux on other cores,
	  typically via /dev/bme/mem.

config TILE_IORPC
	tristate "Tilera user-space device access support"
	default y
	depends on TILEGX
	---help---
	  This kernel driver is required to support direct access
	  to TILE-Gx hardware from user space, via the gxio library.

config TILEPCI_ENDP
	tristate "Tilera PCIE Endpoint Channel Driver"
	default y
	---help---
	  This device is required on Tilera PCI cards; the driver
	  allows Tilera Linux on the chip to communicate with the
	  Intel Linux running on the host.

config TILEPCI_STREAMIO
	tristate "Tilera StreamIO Driver"
	default n
	---help---
	  This driver is responsible for managing the StreamIO links
	  that connect to FPGA devices.

config TILEPCI_HOST_SUBSET
	tristate "Minimal host driver for connecting Tile endpoints"
	default m
	depends on PCI
	---help---
	  Allows a root complex PCIe port to communicate with Tile endpoints.

config TILE_I2CS
	bool "Tilera I2C Slave interface driver"
	default n
	depends on TILEGX && TILE_GXIO && TILE_GXIO_I2CS
	---help---
	  This is a driver for the Tilera I2C Slave interface.

config TILE_TMFIFO
	tristate "Character-device access to the Tilera tile-monitor FIFO"
	default y
	depends on TILEGX
	---help---
	  This device supports communication with an external controller
	  via the tile-monitor FIFO hardware.

config TILE_PKA
	tristate "Character-device access to the Tilera Public Key Accelerator"
	default y
	depends on TILEGX
	---help---
	  This device supports access to the hardware accelerator for
	  mathematical operations related to public key cryptography.
```

## arch/tile/gxio/Kconfig
```kconfig
# Support direct access to TILE-Gx hardware from user space, via the
# gxio library, or from kernel space, via kernel IORPC support.
config TILE_GXIO
	bool
	depends on TILEGX

# Support direct access to the common I/O DMA facility within the
# TILE-Gx mPIPE and Trio hardware from kernel space.
config TILE_GXIO_DMA
	bool
	select TILE_GXIO

# Support direct access to the TILE-Gx mPIPE hardware from kernel space.
config TILE_GXIO_MPIPE
	bool
	select TILE_GXIO
	select TILE_GXIO_DMA

# Support direct access to the TILE-Gx TRIO hardware from kernel space.
config TILE_GXIO_TRIO
	bool
	select TILE_GXIO
	select TILE_GXIO_DMA

# Support direct access to the TILE-Gx USB host hardware from kernel space.
config TILE_GXIO_USB_HOST
	bool
	select TILE_GXIO

# Support direct access to the TILE-Gx UART hardware from kernel space.
config TILE_GXIO_UART
	bool
	select TILE_GXIO

config TILE_GXIO_USB_DEV
	bool "Tilera TILE-Gx USB device hardware support"
	depends on TILEGX
	default n
	select TILE_GXIO
	---help---
	  This option supports direct access to the Tilera TILE-Gx USB device
	  hardware from kernel space.  It is required to enable USB
	  gadget support.  It is not required to allow use of the USB
	  controller in host mode.

config TILE_GXIO_I2CS
	bool "Tilera TILE-Gx I/O I2C slave support"
	depends on TILEGX
	select TILE_GXIO
	---help---
	  This option supports direct access to the Tilera TILE-Gx I2C slave
	  hardware from kernel space.  It is not required in order to use the
	  gxio library to access I2C slave from user space.

config TILE_GXIO_GPIO
	bool "Tilera TILE-Gx GPIO I/O support"
	depends on TILEGX
	default y
	select TILE_GXIO
	---help---
	  This option supports direct access to the Tilera TILE-Gx GPIO
	  hardware from kernel space.  It is not required in order to use the
	  gxio library to access GPIO pins from user space.

config TILE_GXIO_PKA
	bool "Tilera TILE-Gx Public Key Accelerator support"
	depends on TILEGX
	default y
	select TILE_GXIO
	---help---
	  This option supports direct access to the Tilera TILE-Gx PKA hardware
	  from kernel space.

config TILE_GXIO_MICA
	bool "Tilera TILE-Gx Crypto Hardware Acceleration support"
	depends on TILEGX
	default y
	select TILE_GXIO
	---help---
	  This options supports direct access to the crypto acceleration
	  hardware from kernel space.

config TILE_GXIO_GXCR
	bool "Tilera TILE-Gx Crypto library support"
	depends on TILEGX
	default y
	select TILE_GXIO_MICA
	---help---
	  This options supports a mid-level API for access to the
	  Tilera TILE-Gx crypto accelerator engine from kernel space.
```

## arch/tile/kvm/Kconfig
```kconfig
#
# KVM configuration
#

source "virt/kvm/Kconfig"

menuconfig VIRTUALIZATION
	bool "Virtualization"
	---help---
	  Say Y here to get to see options for using your Linux host to run
	  other operating systems inside virtual machines (guests).
	  This option alone does not add any kernel code.

	  If you say N, all options in this submenu will be skipped and
	  disabled.

if VIRTUALIZATION

config KVM
	tristate "Kernel-based Virtual Machine (KVM) support"
	depends on HAVE_KVM && MODULES && EXPERIMENTAL
	select PREEMPT_NOTIFIERS
	select ANON_INODES
	---help---
	  Support hosting paravirtualized guest machines.

	  This module provides access to the hardware capabilities through
	  a character device node named /dev/kvm.

	  If unsure, say N.

source drivers/vhost/Kconfig

config KVM_GUEST
	bool "Build kernel as guest for KVM"
	default n
	depends on TILEGX
	select VIRTIO
	select VIRTIO_RING
	select VIRTIO_CONSOLE
	---help---
	  This will build a kernel that runs at a lower protection level
	  than the default kernel and is suitable to run under KVM.

endif # VIRTUALIZATION
```
